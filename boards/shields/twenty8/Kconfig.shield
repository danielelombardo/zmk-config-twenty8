## boards/shields/twenty8/Kconfig.shield
```kconfig
config SHIELD_TWENTY8_LEFT
	def_bool $(shields_list_contains,twenty8_left)

config SHIELD_TWENTY8_RIGHT
	def_bool $(shields_list_contains,twenty8_right)
```

## config/boards/shields/twenty8/Kconfig.defconfig
```kconfig
config ZMK_BLE
	default y

config ZMK_USB
	default y

if SHIELD_TWENTY8_LEFT

config ZMK_KEYBOARD_NAME
	default "_Twenty8"

config ZMK_SPLIT_BLE_ROLE_CENTRAL
	default y

endif # SHIELD_TWENTY8_LEFT

if SHIELD_TWENTY8_LEFT || SHIELD_TWENTY8_RIGHT

config ZMK_SPLIT
	default y

endif # SHIELD_TWENTY8_LEFT || SHIELD_TWENTY8_RIGHT
```
